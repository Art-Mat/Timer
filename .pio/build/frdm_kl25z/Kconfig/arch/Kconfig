## .pio/build/frdm_kl25z/Kconfig/arch/Kconfig
```kconfig
# Load Zephyr Arch Kconfig descriptions.
osource "/home/artur-mateo/.platformio/packages/framework-zephyr/arch/rx/Kconfig"
osource "/home/artur-mateo/.platformio/packages/framework-zephyr/arch/x86/Kconfig"
osource "/home/artur-mateo/.platformio/packages/framework-zephyr/arch/xtensa/Kconfig"
osource "/home/artur-mateo/.platformio/packages/framework-zephyr/arch/sparc/Kconfig"
osource "/home/artur-mateo/.platformio/packages/framework-zephyr/arch/riscv/Kconfig"
osource "/home/artur-mateo/.platformio/packages/framework-zephyr/arch/posix/Kconfig"
osource "/home/artur-mateo/.platformio/packages/framework-zephyr/arch/mips/Kconfig"
osource "/home/artur-mateo/.platformio/packages/framework-zephyr/arch/arm64/Kconfig"
osource "/home/artur-mateo/.platformio/packages/framework-zephyr/arch/arm/Kconfig"
osource "/home/artur-mateo/.platformio/packages/framework-zephyr/arch/arc/Kconfig"
```

## .pio/build/frdm_kl25z/Kconfig/boards/Kconfig
```kconfig
# Load Zephyr board Kconfig descriptions.
osource "/home/artur-mateo/.platformio/packages/framework-zephyr/boards/nxp/frdm_kl25z/Kconfig"
```
